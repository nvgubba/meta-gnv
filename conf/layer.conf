## conf/layer.conf
```bitbake
# We have a conf and classes directory, add to BBPATH
BBPATH .= ":${LAYERDIR}"

# We have recipes-* directories, add to BBFILES
BBFILES += "${LAYERDIR}/recipes-*/*/*.bb \
            ${LAYERDIR}/recipes-*/*/*.bbappend"

BBFILE_COLLECTIONS += "meta-gnv"
BBFILE_PATTERN_meta-gnv = "^${LAYERDIR}/"
BBFILE_PRIORITY_meta-gnv = "6"

LAYERDEPENDS_meta-gnv = "core"
LAYERSERIES_COMPAT_meta-gnv = "scarthgap"
```
